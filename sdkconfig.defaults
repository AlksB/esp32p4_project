## sdkconfig.defaults
```kconfig
CONFIG_IDF_EXPERIMENTAL_FEATURES=y
CONFIG_SPIRAM=y
CONFIG_SPIRAM_SPEED_200M=y
CONFIG_ESP_DEFAULT_CPU_FREQ_MHZ_360=y
CONFIG_EXAMPLE_USED_LDO_CHAN_ID=3
CONFIG_EXAMPLE_USED_LDO_VOLTAGE_MV=2500
```
